## CMakeLists.txt
```
#
# Copyright (c) 2018 Nordic Semiconductor
#
# SPDX-License-Identifier: LicenseRef-Nordic-5-Clause
#
cmake_minimum_required(VERSION 3.20.0)

find_package(Zephyr REQUIRED HINTS $ENV{ZEPHYR_BASE})
project(NONE)

# NORDIC SDK APP START
target_sources(app PRIVATE
    src/main.c
    src/connection.c
    src/advertising.c
    src/events.c
    src/uart.c
    src/spi.c
    src/int_comm.c
    src/oob.c
    src/trz_nus.c
)


# NORDIC SDK APP END

zephyr_library_include_directories(.)
```

## prj.conf
```kconfig
#
# Copyright (c) 2018 Nordic Semiconductor
#
# SPDX-License-Identifier: LicenseRef-Nordic-5-Clause
#

CONFIG_CLOCK_CONTROL_NRF_K32SRC_RC=y

# Enable the UART driver
CONFIG_UART_ASYNC_API=y
CONFIG_NRFX_UARTE0=y
CONFIG_SERIAL=y

# Enable the SPI driver
CONFIG_SPI=y
CONFIG_NRFX_SPIM0=y
CONFIG_SOC_NRF52832_ALLOW_SPIM_DESPITE_PAN_58=y

CONFIG_GPIO=y



CONFIG_HEAP_MEM_POOL_SIZE=2048




CONFIG_BT=y
CONFIG_BT_PERIPHERAL=y
CONFIG_BT_DEVICE_NAME="TrezorZephyr"
CONFIG_BT_DEVICE_APPEARANCE=833
CONFIG_BT_MAX_CONN=1
CONFIG_BT_MAX_PAIRED=8
CONFIG_BT_SMP=y
# CONFIG_BT_SMP_APP_PAIRING_ACCEPT=y
CONFIG_BT_SMP_ENFORCE_MITM=y
CONFIG_BT_SMP_SC_ONLY=y
CONFIG_BT_FILTER_ACCEPT_LIST=y
CONFIG_BT_BONDING_REQUIRED=y
CONFIG_BT_PRIVACY=y
CONFIG_BT_TINYCRYPT_ECC=y
CONFIG_BT_LL_SW_SPLIT=y

#CONFIG_BT_DEBUG_SMP=y

#PHY update needed for updating PHY request
CONFIG_BT_PHY_UPDATE=y
CONFIG_BT_USER_PHY_UPDATE=y

# HCI ACL buffers size
# BT_L2CAP_RX_MTU = CONFIG_BT_BUF_ACL_RX_SIZE - BT_L2CAP_HDR_SIZE
CONFIG_BT_BUF_ACL_RX_SIZE=251

# L2CAP SDU/PDU TX MTU
CONFIG_BT_L2CAP_TX_MTU=247


# Enable bonding
CONFIG_BT_SETTINGS=y
CONFIG_FLASH=y
CONFIG_FLASH_PAGE_LAYOUT=y
CONFIG_FLASH_MAP=y
CONFIG_NVS=y
CONFIG_SETTINGS=y

# Enable DK LED and Buttons library
CONFIG_DK_LIBRARY=y

# This example requires more stack
CONFIG_MAIN_STACK_SIZE=1152
CONFIG_SYSTEM_WORKQUEUE_STACK_SIZE=4096

# NFC
CONFIG_NFC_T4T_NRFXLIB=y

CONFIG_NFC_NDEF=y
CONFIG_NFC_NDEF_MSG=y
CONFIG_NFC_NDEF_RECORD=y
CONFIG_NFC_NDEF_LE_OOB_REC=y
CONFIG_NFC_NDEF_CH_MSG=y

CONFIG_NFC_NDEF_TNEP_RECORD=y
CONFIG_NFC_TNEP_TAG=y
CONFIG_NFC_NDEF_PARSER=y
CONFIG_NFC_NDEF_CH_PARSER=y
CONFIG_NFC_NDEF_LE_OOB_REC_PARSER=y
CONFIG_NFC_TNEP_CH=y

CONFIG_POLL=y


# Config logger
CONFIG_LOG=y
CONFIG_RTT_CONSOLE=y
CONFIG_UART_CONSOLE=n
CONFIG_USE_SEGGER_RTT=y
CONFIG_LOG_BACKEND_RTT=y
CONFIG_LOG_BACKEND_UART=n
CONFIG_LOG_PRINTK=n

CONFIG_NANOPB=n
CONFIG_ASSERT=y
```

## boards/t3w1_nrf52833.overlay
```dts
/*
 * Copyright (c) 2022 Nordic Semiconductor ASA
 *
 * SPDX-License-Identifier: LicenseRef-Nordic-5-Clause
 */
/ {
	chosen {
		nordic,nus-uart = &uart0;
	};
};

&radio {
	status = "okay";
	/* This is the number of antennas that are available on the antenna matrix
	 * designed by Nordic Semiconductor. For more information see README.rst.
	 */
	dfe-antenna-num = <12>;
	/* This is a setting that enables antenna 0 (in antenna matrix designed
	 * by Nordic Semiconductor) for Rx PDU. For more information see README.rst.
	 */
	dfe-pdu-antenna = <0x0>;

	/* These are GPIO pin numbers that are provided to
	 * Radio peripheral. The pins will be acquired by Radio to
	 * drive antenna switching when AoA is enabled.
	 * Pin numbers are selected to drive switches on antenna matrix
	 * desinged by Nordic Semiconductor. For more information see README.rst.
	 */
	dfegpio0-gpios = <&gpio0 3 0>;
	dfegpio1-gpios = <&gpio0 4 0>;
	dfegpio2-gpios = <&gpio0 28 0>;
	dfegpio3-gpios = <&gpio0 29 0>;
};
```

## src/main.c
```c
/*
 * Copyright (c) 2018 Nordic Semiconductor ASA
 *
 * SPDX-License-Identifier: LicenseRef-Nordic-5-Clause
 */

/** @file
 *  @brief Nordic UART Bridge Service (NUS) sample
 */

#include <zephyr/types.h>
#include <zephyr/kernel.h>
#include <zephyr/drivers/uart.h>

#include <zephyr/device.h>
#include <zephyr/devicetree.h>
#include <soc.h>

#include <zephyr/bluetooth/bluetooth.h>
#include <zephyr/bluetooth/uuid.h>
#include <zephyr/bluetooth/gatt.h>
#include <zephyr/bluetooth/hci.h>
#include <zephyr/bluetooth/conn.h>


#include <dk_buttons_and_leds.h>

#include <zephyr/settings/settings.h>

#include <zephyr/logging/log.h>

#include "uart.h"
#include "spi.h"
#include "connection.h"
#include "int_comm.h"
#include "advertising.h"
#include "trz_nus.h"
#include "oob.h"
#include "events.h"

#define LOG_MODULE_NAME fw
LOG_MODULE_REGISTER(LOG_MODULE_NAME);

#define STACKSIZE CONFIG_BT_NUS_THREAD_STACK_SIZE
#define PRIORITY 7

#define RUN_STATUS_LED DK_LED1
#define RUN_LED_BLINK_INTERVAL 1000

#define FW_RUNNING_SIG DK_LED3
#define CON_STATUS_LED DK_LED2


static K_SEM_DEFINE(ble_init_ok, 0, 1);
static K_SEM_DEFINE(led_init_ok, 0, 1);

#define AUTH_SC_FLAG 0x08


static void security_changed(struct bt_conn *conn, bt_security_t level,
			     enum bt_security_err err)
{
	char addr[BT_ADDR_LE_STR_LEN];

	bt_addr_le_to_str(bt_conn_get_dst(conn), addr, sizeof(addr));

	if (!err) {
		LOG_INF("Security changed: %s level %u", addr, level);
	} else {
		LOG_WRN("Security failed: %s level %u err %d", addr,
			level, err);
	}
}

BT_CONN_CB_DEFINE(conn_callbacks) = {
	.connected    = connected,
	.disconnected = disconnected,
	.security_changed = security_changed,
};

//static enum bt_security_err pairing_accept(struct bt_conn *conn,
//                                           const struct bt_conn_pairing_feat *const feat)
//{
//  if (feat->oob_data_flag && (!(feat->auth_req & AUTH_SC_FLAG))) {
//    bt_le_oob_set_legacy_flag(true);
//  }
//
//  return BT_SECURITY_ERR_SUCCESS;
//
//}


static struct bt_conn_auth_cb conn_auth_callbacks = {
//  .pairing_accept = pairing_accept,
	.passkey_display = auth_passkey_display,
	.passkey_confirm = auth_passkey_confirm,
  .oob_data_request = auth_oob_data_request,
	.cancel = auth_cancel,
};

static struct bt_conn_auth_info_cb conn_auth_info_callbacks = {
	.pairing_complete = pairing_complete,
	.pairing_failed = pairing_failed
};


static void bt_receive_cb(struct bt_conn *conn, const uint8_t *const data,
			  uint16_t len)
{
  if ((dk_get_buttons() & DK_BTN2_MSK) == 0){
    LOG_INF("Trezor not ready, rejecting data");
//    send_error_response();
    return;
  }

	char addr[BT_ADDR_LE_STR_LEN] = {0};

	bt_addr_le_to_str(bt_conn_get_dst(conn), addr, ARRAY_SIZE(addr));

	LOG_DBG("Received data from: %s, %d", addr, len);

  spi_send(data, len);
}

static struct bt_nus_cb nus_cb = {
	.received = bt_receive_cb,
};

void error(void)
{
	dk_set_leds_state(DK_ALL_LEDS_MSK, DK_NO_LEDS_MSK);

	while (true) {
		/* Spin for ever */
		k_sleep(K_MSEC(1000));
	}
}


void button_changed(uint32_t button_state, uint32_t has_changed)
{

}

static void configure_gpio(void)
{
	int err;

	err = dk_buttons_init(button_changed);
	if (err) {
		LOG_ERR("Cannot init buttons (err: %d)", err);
	}

	err = dk_leds_init();
	if (err) {
		LOG_ERR("Cannot init LEDs (err: %d)", err);
	}
}

int main(void)
{
	int err = 0;

  LOG_INF("Initializing");


	configure_gpio();

  err = uart_init();
  if (err) {
    error();
  }

  spi_init();

  err = bt_conn_auth_cb_register(&conn_auth_callbacks);
  if (err) {
    printk("Failed to register authorization callbacks.\n");
    return 0;
  }

  err = bt_conn_auth_info_cb_register(&conn_auth_info_callbacks);
  if (err) {
    printk("Failed to register authorization info callbacks.\n");
    return 0;
  }

	err = bt_enable(NULL);
	if (err) {
		error();
	}

	LOG_INF("Bluetooth initialized");

	k_sem_give(&ble_init_ok);

	if (IS_ENABLED(CONFIG_SETTINGS)) {
		settings_load();
	}

	err = bt_nus_init(&nus_cb);
	if (err) {
		LOG_ERR("Failed to initialize UART service (err: %d)", err);
		return 0;
	}

  bt_set_name("TrezorGAP");

  events_init();
  advertising_init();
  int_comm_start();

  dk_set_led(FW_RUNNING_SIG, 1);
//  dk_set_led(FW_RUNNING_SIG, 0);
//  while(true) {
//    dk_set_led(FW_RUNNING_SIG, 1);
//    dk_set_led(FW_RUNNING_SIG, 0);
//  }
  send_status_event();

  //oob_init();

  k_sem_give(&led_init_ok);

	for (;;) {

    events_poll();
    printk("Event occurred\n");

    //oob_process();
    //int_comm_thread();
	}
}

void ble_write_thread(void)
{
	/* Don't go any further until BLE is initialized */
	k_sem_take(&ble_init_ok, K_FOREVER);

	for (;;) {
		/* Wait indefinitely for data to be sent over bluetooth */
		uart_data_t *buf = uart_get_data_ext();

		if (bt_nus_send(conn_get_current(), buf)) {
			LOG_WRN("Failed to send data over BLE connection: %d", buf->len);
			k_free(buf);
		}

      	LOG_DBG("Freeing UART data");
	}
}

void led_thread(void)
{
	bool connected = false;
	int blink_status = 0;
	/* Don't go any further until BLE is initialized */
	k_sem_take(&led_init_ok, K_FOREVER);

	for (;;) {
		blink_status++;
		dk_set_led(RUN_STATUS_LED, (blink_status) % 2);

		connected = is_connected();

		if (connected) {
			dk_set_led_on(CON_STATUS_LED);
		} else {

			if (is_advertising() && !is_advertising_whitelist()) {
				dk_set_led(CON_STATUS_LED, (blink_status) % 2);
			} else {
				dk_set_led_off(CON_STATUS_LED);
			}
		}


		k_sleep(K_MSEC(RUN_LED_BLINK_INTERVAL));
	}
}


K_THREAD_DEFINE(ble_write_thread_id, STACKSIZE, ble_write_thread, NULL, NULL,
        NULL, PRIORITY, 0, 0);

K_THREAD_DEFINE(led_thread_id, STACKSIZE, led_thread, NULL, NULL,
        NULL, PRIORITY, 0, 0);
```

## src/advertising.c
```c
#include <zephyr/types.h>
#include <zephyr/kernel.h>

#include <zephyr/bluetooth/bluetooth.h>

#include <zephyr/logging/log.h>

#include "int_comm.h"
#include "connection.h"
#include "oob.h"
#include "trz_nus.h"


#define LOG_MODULE_NAME fw_int_advertising
LOG_MODULE_REGISTER(LOG_MODULE_NAME);


#define DEVICE_NAME CONFIG_BT_DEVICE_NAME
#define DEVICE_NAME_LEN	(sizeof(DEVICE_NAME) - 1)

bool advertising = false;
bool advertising_wl = false;
int bond_cnt = 0;
int bond_cnt_tmp = 0;

uint8_t pairing_data[2] = {0};

static const struct bt_data advertising_data[] = {
  BT_DATA_BYTES(BT_DATA_FLAGS, (BT_LE_AD_GENERAL | BT_LE_AD_NO_BREDR)),
  BT_DATA(BT_DATA_NAME_COMPLETE, DEVICE_NAME, DEVICE_NAME_LEN),
  BT_DATA(BT_DATA_MANUFACTURER_DATA, pairing_data, 2),
};


static const struct bt_data scan_response_data[] = {
  BT_DATA_BYTES(BT_DATA_UUID128_ALL, BT_UUID_NUS_VAL),
};

static void add_to_whitelist(const struct bt_bond_info *info, void *user_data){
  char addr[BT_ADDR_LE_STR_LEN];
  bt_addr_le_to_str(&info->addr, addr, sizeof(addr));

  int err = bt_le_filter_accept_list_add(&info->addr);
  if (err){
    LOG_WRN("whitelist add: %s FAILED!\n", addr);
  }else{
    LOG_INF("whitelist add: %s\n", addr);
  }

  bond_cnt_tmp++;
}


void advertising_setup_wl(void) {
  bt_le_filter_accept_list_clear();
  bond_cnt_tmp= 0;
  bt_foreach_bond(BT_ID_DEFAULT, add_to_whitelist, NULL);
  bond_cnt = bond_cnt_tmp;
}

void advertising_start(bool wl){

  if (advertising) {
    if (wl != advertising_wl) {
      LOG_WRN("Restarting advertising");
      bt_le_adv_stop();
    }else {
      LOG_WRN("Already advertising");

      send_status_event();
      return;
    }
  }

  int err;

  pairing_data[1] = 0x00; // todo color

  if (wl) {
    advertising_setup_wl();
    LOG_INF("Advertising with whitelist");

    pairing_data[0] = 0x00;

    err = bt_le_adv_start(
            BT_LE_ADV_PARAM(BT_LE_ADV_OPT_CONNECTABLE | BT_LE_ADV_OPT_SCANNABLE | BT_LE_ADV_OPT_FILTER_CONN | BT_LE_ADV_OPT_FILTER_SCAN_REQ,
                            160, 1600, NULL),
            advertising_data, ARRAY_SIZE(advertising_data),
            scan_response_data, ARRAY_SIZE(scan_response_data));
  }
  else {
    LOG_INF("Advertising no whitelist");

    pairing_data[0] = 0x01;

    err = bt_le_adv_start(
            BT_LE_ADV_PARAM(BT_LE_ADV_OPT_CONNECTABLE | BT_LE_ADV_OPT_SCANNABLE,
                            160, 1600, NULL),
            advertising_data, ARRAY_SIZE(advertising_data),
            scan_response_data, ARRAY_SIZE(scan_response_data));
  }
  if (err) {
    LOG_ERR("Advertising failed to start (err %d)", err);
    send_status_event();
    return;
  }
  advertising = true;
  advertising_wl = wl;


  oob_fetch_addr();

  send_status_event();
}

void advertising_stop(void){

  if (!advertising) {
    LOG_WRN("Not advertising");

    send_status_event();
    return;
  }

  int err = bt_le_adv_stop();
  if (err) {
    LOG_ERR("Advertising failed to stop (err %d)", err);
    send_status_event();
    return;
  }
  advertising = false;
  advertising_wl = false;
  send_status_event();
}

bool is_advertising(void){
  return advertising;
}

bool is_advertising_whitelist(void){
  return advertising_wl;
}


void advertising_init(void){
  LOG_INF("Advertising init");
  advertising_setup_wl();
}

void erase_bonds(void){
  int err = bt_unpair(BT_ID_DEFAULT, BT_ADDR_LE_ANY);
  if (err) {
    LOG_INF("Cannot delete bonds (err: %d)\n", err);
  } else {
  	bt_le_filter_accept_list_clear();
  	bond_cnt = 0;
    LOG_INF("Bonds deleted successfully \n");
  }
}

int advertising_get_bond_count(void){
  return bond_cnt;
}
```

## src/connection.c
```c
#include <zephyr/types.h>
#include <zephyr/kernel.h>

#include <zephyr/bluetooth/bluetooth.h>
#include <zephyr/bluetooth/uuid.h>
#include <zephyr/bluetooth/gatt.h>
#include <zephyr/bluetooth/hci.h>

#include <zephyr/logging/log.h>

#include <dk_buttons_and_leds.h>

#include "connection.h"
#include "advertising.h"
#include "int_comm.h"
#include "oob.h"

#define LOG_MODULE_NAME fw_int_connection
LOG_MODULE_REGISTER(LOG_MODULE_NAME);

static struct bt_conn *current_conn;
static struct bt_conn *auth_conn;

void connected(struct bt_conn *conn, uint8_t err)
{
  char addr[BT_ADDR_LE_STR_LEN];

  if (err) {
    LOG_ERR("Connection failed (err %u)", err);
    return;
  }

  bt_addr_le_to_str(bt_conn_get_dst(conn), addr, sizeof(addr));
  LOG_INF("Connected %s", addr);

  current_conn = bt_conn_ref(conn);

//  struct bt_le_conn_param params = BT_LE_CONN_PARAM_INIT(6,6,0,400);
//
//  bt_conn_le_param_update(conn, &params);

  // err = bt_conn_le_phy_update(current_conn, BT_CONN_LE_PHY_PARAM_2M);
  // if (err) {
  //   LOG_ERR("Phy update request failed: %d",  err);
  // }

  send_status_event();
}

void disconnected(struct bt_conn *conn, uint8_t reason)
{
  char addr[BT_ADDR_LE_STR_LEN];

  bt_addr_le_to_str(bt_conn_get_dst(conn), addr, sizeof(addr));

  LOG_INF("Disconnected: %s (reason %u)", addr, reason);

  if (auth_conn) {
    bt_conn_unref(auth_conn);
    auth_conn = NULL;
  }

  if (current_conn) {
    bt_conn_unref(current_conn);
    current_conn = NULL;
  }

  send_status_event();
}

bool is_connected(void) {
  return current_conn != NULL;
}


void disconnect(void){
  if (current_conn) {
    LOG_INF("Remotely disconnected");
    bt_conn_disconnect(current_conn, BT_HCI_ERR_REMOTE_USER_TERM_CONN);
    bt_conn_unref(current_conn);
  }
}

void num_comp_reply(bool accept)
{


  if (auth_conn != NULL) {
    if (accept) {
      bt_conn_auth_passkey_confirm(auth_conn);
      LOG_INF("Numeric Match, conn %p", (void *)auth_conn);
    } else {
      bt_conn_auth_cancel(auth_conn);
      LOG_INF("Numeric Reject, conn %p", (void *)auth_conn);
      bt_conn_disconnect(auth_conn, BT_HCI_ERR_REMOTE_USER_TERM_CONN);
    }

    bt_conn_unref(auth_conn);
    auth_conn = NULL;
  }
}

void passkey_to_str(uint8_t buf[6], unsigned int passkey) {
  buf[5] = (passkey % 10) + '0';
  buf[4] = ((passkey / 10) % 10) + '0';
  buf[3] = ((passkey / 100) % 10) + '0';
  buf[2] = ((passkey / 1000) % 10) + '0';
  buf[1] = ((passkey / 10000) % 10) + '0';
  buf[0] = ((passkey / 100000) % 10) + '0';
}

void auth_passkey_display(struct bt_conn *conn, unsigned int passkey)
{
  char addr[BT_ADDR_LE_STR_LEN];

  uint8_t passkey_str[6];
  passkey_to_str(passkey_str, passkey);
  bt_addr_le_to_str(bt_conn_get_dst(conn), addr, sizeof(addr));

  //pb_comm_enqueue(PASSKEY_DISPLAY, passkey_str, 6);
}

void auth_passkey_confirm(struct bt_conn *conn, unsigned int passkey)
{
  char addr[BT_ADDR_LE_STR_LEN];

  auth_conn = bt_conn_ref(conn);

  bt_addr_le_to_str(bt_conn_get_dst(conn), addr, sizeof(addr));

  uint8_t passkey_str[6];
  passkey_to_str(passkey_str, passkey);
  send_pairing_request_event(passkey_str, 6);

  send_status_event();

}


void auth_cancel(struct bt_conn *conn)
{
  char addr[BT_ADDR_LE_STR_LEN];

  bt_addr_le_to_str(bt_conn_get_dst(conn), addr, sizeof(addr));

  disconnect();

  send_pairing_cancelled_event();
  send_status_event();

  LOG_INF("Pairing cancelled: %s", addr);
}



void pairing_complete(struct bt_conn *conn, bool bonded)
{
  char addr[BT_ADDR_LE_STR_LEN];

  bt_addr_le_to_str(bt_conn_get_dst(conn), addr, sizeof(addr));

  oob_signal();
  bt_le_oob_set_sc_flag(false);
  bt_le_oob_set_legacy_flag(false);

  if (bonded) {
    advertising_setup_wl();
  }

  LOG_INF("Pairing completed: %s, bonded: %d", addr, bonded);
}


void pairing_failed(struct bt_conn *conn, enum bt_security_err reason)
{
  char addr[BT_ADDR_LE_STR_LEN];

  bt_addr_le_to_str(bt_conn_get_dst(conn), addr, sizeof(addr));

  oob_signal();
  bt_le_oob_set_sc_flag(false);
  bt_le_oob_set_legacy_flag(false);

  LOG_INF("Pairing failed conn: %s, reason %d", addr, reason);
}


struct bt_conn * conn_get_current(void){
  return current_conn;
}
```

## src/int_comm.c
```c
#include <stdint.h>
#include <stdbool.h>

#include <zephyr/types.h>
#include <zephyr/kernel.h>

#include <zephyr/logging/log.h>
#include <zephyr/sys/crc.h>

#include "uart.h"
#include "int_comm_defs.h"
#include "connection.h"
#include "advertising.h"
#include "events.h"

#define LOG_MODULE_NAME fw_int_comm
LOG_MODULE_REGISTER(LOG_MODULE_NAME);

static K_SEM_DEFINE(int_comm_ok, 0, 1);



void send_packet(uint8_t message_type, const uint8_t *tx_data, uint8_t len) {
  uart_data_t *tx = k_malloc(sizeof(*tx));

  if (tx == NULL) {
    LOG_WRN("Not able to allocate UART send data buffer");
    return;
  }

  LOG_DBG("ALLOC: Sending UART data");

  tx->len = len + OVERHEAD_SIZE;

  tx->data[0] = message_type;
  tx->data[1] = tx->len;
  memcpy(&tx->data[COMM_HEADER_SIZE], tx_data, len);

  uint8_t crc = crc8(tx->data, tx->len-1, 0x07, 0x00, false);

  tx->data[tx->len-1] = crc;

  uart_send(tx);

}

void send_status_event(void) {
//  ble_version_t version = {0};
//
//  sd_ble_version_get(&version);
  LOG_WRN("Sending status event: connected: %d, advertising: %d, advertising_whitelist: %d, peer_count: %d",
          is_connected(), is_advertising(), is_advertising_whitelist(), advertising_get_bond_count());

  event_status_msg_t msg = {0};
  msg.msg_id = INTERNAL_EVENT_STATUS;
  msg.connected = is_connected();
  msg.advertising = is_advertising();
  msg.advertising_whitelist = is_advertising_whitelist();
  msg.peer_count = advertising_get_bond_count();
  msg.sd_version_number = 0;
  msg.sd_company_id = 0;
  msg.sd_subversion_number = 0;
  msg.app_version = 0;
  msg.bld_version = 0;

  send_packet(INTERNAL_EVENT, (uint8_t *)&msg, sizeof(msg));
}


void send_success_event(void) {
  uint8_t tx_data[] = {
          INTERNAL_EVENT_SUCCESS,
  };
  send_packet(INTERNAL_EVENT, tx_data, sizeof(tx_data));
}


void send_pairing_cancelled_event(void){
  uint8_t tx_data[1] = {0};

  tx_data[0] = INTERNAL_EVENT_PAIRING_CANCELLED;

  send_packet(INTERNAL_EVENT, tx_data, sizeof(tx_data));
}


void send_pairing_request_event(uint8_t * data, uint16_t len){
  uint8_t tx_data[7] = {0};

  tx_data[0] = INTERNAL_EVENT_PAIRING_REQUEST;
  tx_data[1] = data[0];
  tx_data[2] = data[1];
  tx_data[3] = data[2];
  tx_data[4] = data[3];
  tx_data[5] = data[4];
  tx_data[6] = data[5];

  send_packet(INTERNAL_EVENT, tx_data, sizeof(tx_data));
}

uint16_t get_message_type(const uint8_t *rx_data) {
  return (rx_data[3] << 8) | rx_data[4];
}


void process_command(uint8_t *data, uint16_t len) {
  uint8_t cmd = data[0];
  switch (cmd) {
    case INTERNAL_CMD_SEND_STATE:
      send_status_event();
      break;
    case INTERNAL_CMD_ADVERTISING_ON:
      advertising_start(data[1] != 0);
      break;
    case INTERNAL_CMD_ADVERTISING_OFF:
      advertising_stop();
      break;
    case INTERNAL_CMD_ERASE_BONDS:
      erase_bonds();
      send_success_event();
      break;
    case INTERNAL_CMD_DISCONNECT:
      disconnect();
      send_success_event();
    case INTERNAL_CMD_ACK:
      //pb_msg_ack();
      break;
    case INTERNAL_CMD_ALLOW_PAIRING:
      num_comp_reply(true);
      send_success_event();
      break;
    case INTERNAL_CMD_REJECT_PAIRING:
      num_comp_reply(false);
      send_success_event();
      break;
    default:
      break;
  }
}


void int_comm_start(void)
{
  k_sem_give(&int_comm_ok);
}


void int_comm_thread(void)
{
  /* Don't go any further until BLE is initialized */
  k_sem_take(&int_comm_ok, K_FOREVER);

  for (;;) {

   // events_poll();

    //if (events_get(INT_COMM_EVENT_NUM)->state == K_POLL_STATE_SIGNALED) {

      uart_data_t *buf = uart_get_data_int();
      process_command(buf->data, buf->len);
      k_free(buf);

     // k_poll_signal_reset(events_get(INT_COMM_EVENT_NUM)->signal);
      //events_get(INT_COMM_EVENT_NUM)->state = K_POLL_STATE_NOT_READY;
    //}


  }
}

K_THREAD_DEFINE(int_comm_thread_id, CONFIG_BT_NUS_THREAD_STACK_SIZE, int_comm_thread, NULL, NULL,
        NULL, 7, 0, 0);
```

## src/int_comm.h
```c
#ifndef INT_COMM__
#define INT_COMM__

#include <stdint.h>

void process_command(uint8_t *data, uint16_t len);

void send_status_event(void);

void send_pairing_request_event(uint8_t * data, uint16_t len);
void send_pairing_cancelled_event(void);

void int_comm_start(void);

void int_comm_thread(void);

void send_packet(uint8_t message_type, const uint8_t *tx_data, uint16_t len);

void pb_msg_ack(void);

#endif
```

## src/trz_nus.h
```c
/*
 * Copyright (c) 2018 Nordic Semiconductor ASA
 *
 * SPDX-License-Identifier: LicenseRef-Nordic-5-Clause
 */

#ifndef BT_NUS_H_
#define BT_NUS_H_

/**
 * @file
 * @defgroup bt_nus Nordic UART (NUS) GATT Service
 * @{
 * @brief Nordic UART (NUS) GATT Service API.
 */

#include <zephyr/types.h>
#include <zephyr/bluetooth/conn.h>
#include <zephyr/bluetooth/uuid.h>
#include <zephyr/bluetooth/gatt.h>

#include "uart.h"

#ifdef __cplusplus
extern "C" {
#endif

 /** @brief UUID of the NUS Service. **/
#define BT_UUID_NUS_VAL \
BT_UUID_128_ENCODE(0x8c000001, 0xa59b, 0x4d58, 0xa9ad, 0x073df69fa1b1)

 /** @brief UUID of the TX Characteristic. **/
#define BT_UUID_NUS_TX_VAL \
BT_UUID_128_ENCODE(0x8c000003, 0xa59b, 0x4d58, 0xa9ad, 0x073df69fa1b1)

 /** @brief UUID of the RX Characteristic. **/
#define BT_UUID_NUS_RX_VAL \
BT_UUID_128_ENCODE(0x8c000002, 0xa59b, 0x4d58, 0xa9ad, 0x073df69fa1b1)

#define BT_UUID_NUS_SERVICE   BT_UUID_DECLARE_128(BT_UUID_NUS_VAL)
#define BT_UUID_NUS_RX        BT_UUID_DECLARE_128(BT_UUID_NUS_RX_VAL)
#define BT_UUID_NUS_TX        BT_UUID_DECLARE_128(BT_UUID_NUS_TX_VAL)


/** @brief NUS send status. */
enum bt_nus_send_status {
    /** Send notification enabled. */
    BT_NUS_SEND_STATUS_ENABLED,
    /** Send notification disabled. */
    BT_NUS_SEND_STATUS_DISABLED,
};

/** @brief Pointers to the callback functions for service events. */
struct bt_nus_cb {
    /** @brief Data received callback.
     *
     * The data has been received as a write request on the NUS RX
     * Characteristic.
     *
     * @param[in] conn  Pointer to connection object that has received data.
     * @param[in] data  Received data.
     * @param[in] len   Length of received data.
     */
    void (*received)(struct bt_conn *conn,
                     const uint8_t *const data, uint16_t len);

    /** @brief Data sent callback.
     *
     * The data has been sent as a notification and written on the NUS TX
     * Characteristic.
     *
     * @param[in] conn Pointer to connection object, or NULL if sent to all
     *                 connected peers.
     */
    void (*sent)(struct bt_conn *conn);

    /** @brief Send state callback.
     *
     * Indicate the
     * CCCD descriptor status of the NUS TX characteristic.
     *
     * @param[in] status Send notification status.
     */
    void (*send_enabled)(enum bt_nus_send_status status);

};

/**@brief Initialize the service.
 *
 * @details This function registers a GATT service with two characteristics,
 *          TX and RX. A remote device that is connected to this service
 *          can send data to the RX Characteristic. When the remote enables
 *          notifications, it is notified when data is sent to the TX
 *          Characteristic.
 *
 * @param[in] callbacks  Struct with function pointers to callbacks for service
 *                       events. If no callbacks are needed, this parameter can
 *                       be NULL.
 *
 * @retval 0 If initialization is successful.
 *           Otherwise, a negative value is returned.
 */
int bt_nus_init(struct bt_nus_cb *callbacks);

/**@brief Send data.
 *
 * @details This function sends data to a connected peer, or all connected
 *          peers.
 *
 * @param[in] conn Pointer to connection object, or NULL to send to all
 *                 connected peers.
 * @param[in] buf  Pointer to a data buffer.
 *
 * @retval 0 If the data is sent.
 *           Otherwise, a negative value is returned.
 */
int bt_nus_send(struct bt_conn *conn, uart_data_t *data);

/**@brief Get maximum data length that can be used for @ref bt_nus_send.
 *
 * @param[in] conn Pointer to connection Object.
 *
 * @return Maximum data length.
 */
static inline uint32_t bt_nus_get_mtu(struct bt_conn *conn)
{
  /* According to 3.4.7.1 Handle Value Notification off the ATT protocol.
   * Maximum supported notification is ATT_MTU - 3 */
  return bt_gatt_get_mtu(conn) - 3;
}

#ifdef __cplusplus
}
#endif

/**
 *@}
 */

#endif /* BT_NUS_H_ */
```

## src/uart.c
```c
#include <zephyr/types.h>
#include <zephyr/kernel.h>
#include <zephyr/drivers/uart.h>

#include <zephyr/device.h>
#include <zephyr/devicetree.h>

#include <dk_buttons_and_leds.h>

#include <zephyr/settings/settings.h>
#include <zephyr/logging/log.h>
#include <zephyr/sys/crc.h>

#include "uart.h"
#include "int_comm.h"
#include "int_comm_defs.h"
#include "events.h"

#define LOG_MODULE_NAME fw_uart
LOG_MODULE_REGISTER(LOG_MODULE_NAME);

#define UART_WAIT_FOR_BUF_DELAY K_MSEC(50)
#define UART_WAIT_FOR_RX CONFIG_BT_NUS_UART_RX_WAIT_TIME

static const struct device *uart = DEVICE_DT_GET(DT_CHOSEN(nordic_nus_uart));

static K_FIFO_DEFINE(fifo_uart_tx_data);
static K_FIFO_DEFINE(fifo_uart_rx_data);
static K_FIFO_DEFINE(fifo_uart_rx_data_int);


static struct k_work_delayable uart_work;



static volatile bool g_uart_rx_running = false;


static void uart_cb(const struct device *dev, struct uart_event *evt, void *user_data)
{
  ARG_UNUSED(dev);

  static size_t aborted_len;
  uart_data_t *buf;
  static uint8_t *aborted_buf;
  static bool disable_req;
  static uint8_t rx_phase = 0;
  static uint8_t rx_msg_type = 0;
  static uint8_t rx_data_len = 0;
  static uint8_t rx_len = 0;
  static uint8_t crc = 0;

  switch (evt->type) {
    case UART_TX_DONE:
      LOG_DBG("UART_TX_DONE");


      if (evt->data.tx.buf == NULL) {
        return;
      }

      if (evt->data.tx.len == 0) {
        buf = CONTAINER_OF(evt->data.tx.buf, uart_data_t, data[0]);

      	LOG_DBG("Free uart data");
      	k_free(buf);
        return;
      }

      if (aborted_buf) {
        buf = CONTAINER_OF(aborted_buf, uart_data_t,
        data[0]);
        aborted_buf = NULL;
        aborted_len = 0;
      } else {
        buf = CONTAINER_OF(evt->data.tx.buf, uart_data_t,
        data[0]);
      }

      LOG_DBG("Free uart data");
      k_free(buf);

      buf = k_fifo_get(&fifo_uart_tx_data, K_NO_WAIT);
      if (!buf) {
        return;
      }

      if (!uart_tx(uart, buf->data, buf->len, SYS_FOREVER_MS)) {
        LOG_WRN("FREE: Failed to send data over UART");
      }

      break;

    case UART_RX_RDY:
//      LOG_WRN("UART_RX_RDY");
      buf = CONTAINER_OF(evt->data.rx.buf, uart_data_t, data[0]);
      buf->len += evt->data.rx.len;

      switch(rx_phase) {
        case 0:
          if (buf->len == 1 && (buf->data[0] == INTERNAL_EVENT || buf->data[0] == EXTERNAL_MESSAGE) ) {
            rx_phase = 1;
            rx_msg_type = buf->data[0];
            crc = crc8(buf->data, buf->len, 0x07, 0x00, false);
          } else {
            rx_phase = 0;
          }
          break;
        case 1:
          if (buf->len == 1) {
            rx_data_len = buf->data[0];
            crc = crc8(buf->data, buf->len, 0x07, crc, false);
            rx_phase = 2;
          } else{
            rx_phase = 0;
          }
          break;
        case 2:
          if (buf->len != rx_data_len - COMM_HEADER_SIZE) {
            rx_phase = 0;
          }

          crc = crc8(buf->data, buf->len - 1, 0x07, crc, false);

          if (crc != buf->data[buf->len - 1]) {
            LOG_WRN("UART_RX CRC ERROR");
            rx_phase = 0;
          }

          rx_phase = 3;
          break;
      }

//		if (disable_req) {
//			return;
//		}

//		if ((evt->data.rx.buf[buf->len - 1] == '\n') ||
//		    (evt->data.rx.buf[buf->len - 1] == '\r')) {
//			disable_req = true;
//			uart_rx_disable(uart);
//		}

      break;

    case UART_RX_DISABLED:
      LOG_DBG("UART_RX_DISABLED");
      disable_req = false;

      LOG_DBG("UART_RX_MALLOC");
      buf = k_malloc(sizeof(*buf));

      if (buf) {

        switch (rx_phase) {
          case 0:
            rx_len = 1;
            break;
          case 1:
            rx_len = 1;
            break;
          case 2:
            rx_len = rx_data_len - COMM_HEADER_SIZE;
            break;

          default:
            rx_len = 1;
            break;
        }

        buf->len = 0;
        uart_rx_enable(uart, buf->data, rx_len, SYS_FOREVER_US);
      } else {
        LOG_WRN("Not able to allocate UART receive buffer");
        k_work_reschedule(&uart_work, UART_WAIT_FOR_BUF_DELAY);
        g_uart_rx_running = false;
      }

//		buf = k_malloc(sizeof(*buf));
//		if (buf) {
//			buf->len = 0;
//		} else {
//			LOG_WRN("Not able to allocate UART receive buffer");
//
//			return;
//		}
//
//		uart_rx_enable(uart, buf->data, sizeof(buf->data),
//			       UART_WAIT_FOR_RX);

      break;

//	case UART_RX_BUF_REQUEST:
//		LOG_INF("UART_RX_BUF_REQUEST");
//		buf = k_malloc(sizeof(*buf));
//
//
//		if (buf) {
//
//      switch (rx_phase) {
//        case 0:
//          rx_len = 1;
//          break;
//        case 1:
//          rx_len = 2;
//          break;
//        default:
//          rx_len = 1;
//          break;
//      }
//
//			buf->len = 0;
//      LOG_INF("Providing buf %d", rx_len);
//			uart_rx_buf_rsp(uart, buf->data, rx_len);
//		} else {
//			LOG_WRN("Not able to allocate UART receive buffer");
//		}
//
//		break;

    case UART_RX_BUF_RELEASED:
      LOG_DBG("UART_RX_BUF_RELEASED");
      buf = CONTAINER_OF(evt->data.rx_buf.buf, uart_data_t,
      data[0]);

      if (rx_phase == 3 && buf->len > 0) {
        buf->len -= COMM_FOOTER_SIZE;
        if (rx_msg_type == EXTERNAL_MESSAGE) {
          k_fifo_put(&fifo_uart_rx_data, buf);
        }
        else  if (rx_msg_type == INTERNAL_EVENT) {
          k_fifo_put(&fifo_uart_rx_data_int, buf);
        } else {
      		//LOG_WRN("UART_RX BAD MASSAGE TYPE");
          k_free(buf);
        }
        rx_data_len= 0;
        rx_len = 0;
        rx_msg_type = 0;
        rx_phase = 0;
      } else {
        k_free(buf);
      }
      break;

    case UART_TX_ABORTED:
      LOG_DBG("UART_TX_ABORTED");
      if (!aborted_buf) {
        aborted_buf = (uint8_t *)evt->data.tx.buf;
      }

      aborted_len += evt->data.tx.len;
      buf = CONTAINER_OF(aborted_buf, uart_data_t,
      data[0]);

      uart_tx(uart, &buf->data[aborted_len],
              buf->len - aborted_len, SYS_FOREVER_MS);

      break;

    default:
      break;
  }
}


int uart_start_rx(void) {
  int err;
  uart_data_t *rx;

  rx = k_malloc(sizeof(*rx));
  if (rx) {
    rx->len = 0;
  } else {
    return -ENOMEM;
  }

  // receive message type
  err = uart_rx_enable(uart, rx->data, 1, SYS_FOREVER_US);
  if (err) {
    LOG_ERR("Cannot enable uart reception (err: %d)", err);
    /* Free the rx buffer only because the tx buffer will be handled in the callback */
    k_free(rx);
  } else {
    g_uart_rx_running = true;
  }

  return err;
}

static void uart_work_handler(struct k_work *item)
{
	uart_data_t *buf;

	buf = k_malloc(sizeof(*buf));
	if (buf) {
		buf->len = 0;
	} else {
		LOG_WRN("Not able to allocate UART receive buffer");
		k_work_reschedule(&uart_work, UART_WAIT_FOR_BUF_DELAY);
		return;
	}

	uart_rx_enable(uart, buf->data, 1, SYS_FOREVER_US);
}


int uart_init(void)
{
  int err;


  if (!device_is_ready(uart)) {
    return -ENODEV;
  }


  k_work_init_delayable(&uart_work, uart_work_handler);

  struct uart_config cfg = {
          .baudrate = 1000000,
          .parity = UART_CFG_PARITY_NONE,
          .stop_bits = UART_CFG_STOP_BITS_1,
          .data_bits = UART_CFG_DATA_BITS_8,
          .flow_ctrl = UART_CFG_FLOW_CTRL_RTS_CTS,

  };

  uart_configure(uart, &cfg);

  err = uart_callback_set(uart, uart_cb, NULL);
  if (err) {
    LOG_ERR("Cannot initialize UART callback");
    return err;
  }

  return uart_start_rx();
}


void uart_send_ext(uart_data_t *tx)
{
  k_fifo_put(&fifo_uart_rx_data, tx);
}

uart_data_t *uart_get_data_ext(void)
{
  return k_fifo_get(&fifo_uart_rx_data, K_FOREVER);
}

uart_data_t *uart_get_data_int(void)
{
  return k_fifo_get(&fifo_uart_rx_data_int, K_FOREVER);
}
//
//uart_data_t *uart_get_data_pb(void)
//{
//  return k_fifo_get(&fifo_uart_rx_data_pb, K_MSEC(100));
//}
//
//void uart_data_pb_flush(void){
//  while(uart_get_data_pb() != NULL);
//}

void uart_send(uart_data_t *tx)
{
  int err = uart_tx(uart, tx->data, tx->len, SYS_FOREVER_MS);
  if (err) {
    k_fifo_put(&fifo_uart_tx_data, tx);
  }
}
```
